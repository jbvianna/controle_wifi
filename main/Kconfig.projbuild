## main/Kconfig.projbuild
```kconfig
menu "App Wifi Configuration"

    config ESP_WIFI_SSID
        string "WiFi SSID"
        default "espiot"
        help
            SSID (network name) for the Wifi connection.

    config ESP_WIFI_PASSWORD
        string "WiFi Password"
        default ""
        help
            WiFi password (WPA or WPA2) for the  Wifi connection.

    config ESP_MAXIMUM_RETRY
        int "Maximum retry"
        default 5
        help
            Set the Maximum retry to avoid station reconnecting to the AP unlimited when the AP is really inexistent.

    choice ESP_WIFI_SCAN_AUTH_MODE_THRESHOLD
        prompt "WiFi Scan auth mode threshold"
        default ESP_WIFI_AUTH_WPA2_PSK
        help
            The weakest authmode to accept in the scan mode.
            This value defaults to ESP_WIFI_AUTH_WPA2_PSK incase password is present and ESP_WIFI_AUTH_OPEN is used.
            Please select ESP_WIFI_AUTH_WEP/ESP_WIFI_AUTH_WPA_PSK incase AP is operating in WEP/WPA mode.

        config ESP_WIFI_AUTH_OPEN
            bool "OPEN"
        config ESP_WIFI_AUTH_WEP
            bool "WEP"
        config ESP_WIFI_AUTH_WPA_PSK
            bool "WPA PSK"
        config ESP_WIFI_AUTH_WPA2_PSK
            bool "WPA2 PSK"
        config ESP_WIFI_AUTH_WPA_WPA2_PSK
            bool "WPA/WPA2 PSK"
        config ESP_WIFI_AUTH_WPA3_PSK
            bool "WPA3 PSK"
        config ESP_WIFI_AUTH_WPA2_WPA3_PSK
            bool "WPA2/WPA3 PSK"
        config ESP_WIFI_AUTH_WAPI_PSK
            bool "WAPI PSK"
    endchoice

    config ESP_WIFI_CHANNEL
        int "WiFi Channel"
        range 1 13
        default 1
        help
            WiFi channel (network channel) for the Access Point connection.

    config ESP_MAX_STA_CONN
        int "Maximum STA connections"
        default 4
        help
            Maximum number of station (STA) connects to the access point (AP).

endmenu

menu "App mDNS Configuration"

    config MDNS_HOSTNAME
        string "mDNS Hostname"
        default "esp32-modulo01"
        help
            mDNS Hostname for example to use

    config MDNS_INSTANCE
        string "mDNS Instance Name"
        default "Servidor ESP32"
        help
            mDNS Instance Name for example to use

    config MDNS_RESOLVE_TEST_SERVICES
        bool "Resolve test services"
        default n
        help
            Enable resolving test services on startup.
            These services are advertized and evaluated in automated tests.
            When executed locally, these will not be resolved and warnings appear in the log.
            Please set to false to disable initial querying to avoid warnings.

endmenu

menu "App HTTP Server Configuration"
    config HTTP_SERVER_PORT
        int "Server Port"
        default 80
        help
            Choose in wich port the server will listen (80, 8008, 8080).
            
    config EXAMPLE_BASIC_AUTH
        bool "Basic Authentication"
        default n
        help
            Basic Authentication is a method for an HTTP user agent (e.g. a web browser)
            to provide a user name and password when making a request. It is the simplest
            technique for enforcing access controls to web resources. because it doesn't
            require cookies, session identifiers, or login pages; rather, it uses standard
            fields in the HTTP header.
            Note that, Basic Authentication is not encrypted channel and also easy to retrieve
            credentials as they are sent in plain text format.

    config EXAMPLE_BASIC_AUTH_USERNAME
        string "Basic Authenticate User Name"
        depends on EXAMPLE_BASIC_AUTH
        default "ESP32"
        help
            The client's user name which used for basic authenticate.

    config EXAMPLE_BASIC_AUTH_PASSWORD
        string "Basic Authenticate Password"
        depends on EXAMPLE_BASIC_AUTH
        default "ESP32Webserver"
        help
            The client's password which used for basic authenticate.

endmenu
```
